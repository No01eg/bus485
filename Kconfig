## Kconfig
```kconfig
config STRIM_BUS485
    bool "Strim bus485"
    default n 
    depends on UART_INTERRUPT_DRIVEN && GPIO
    help
        Enable the strim bus485 driver.

if STRIM_BUS485        

config STRIM_BUS485_INIT_PRIORITY
    int "Initialization priority"
    default 50
    range 1 100

config STRIM_BUS485_RX_QUEUE_SIZE
    int "Size of receive queue"
    default 256
    range 1 256

config STRIM_BUS485_TX_QUEUE_SIZE
    int "Size of transmit queue"
    default 256
    range 1 256

config STRIM_BUS485_RECV_SYM_IDLE_COUNT
    int "count symbols for wait idle status on bus"
    default 5
    range 3 5

module = BUS485
module-str = bus485
source "subsys/logging/Kconfig.template.log_config"

endif # STRIM_BUS485
```

## bus485/dts/bindings/serial/strim,bus485.yaml
```yaml
description: Strim bus485

compatible: "strim,bus485"

include: uart-device.yaml

properties:
  pin-gpios:
    type: phandle-array
    
```

## bus485/sample/build/Kconfig/arch/Kconfig
```kconfig
# Load Zephyr Arch Kconfig descriptions.
osource "/home/no01eg/zephyrproject/zephyr/arch/rx/Kconfig"
osource "/home/no01eg/zephyrproject/zephyr/arch/x86/Kconfig"
osource "/home/no01eg/zephyrproject/zephyr/arch/xtensa/Kconfig"
osource "/home/no01eg/zephyrproject/zephyr/arch/sparc/Kconfig"
osource "/home/no01eg/zephyrproject/zephyr/arch/riscv/Kconfig"
osource "/home/no01eg/zephyrproject/zephyr/arch/posix/Kconfig"
osource "/home/no01eg/zephyrproject/zephyr/arch/mips/Kconfig"
osource "/home/no01eg/zephyrproject/zephyr/arch/arm64/Kconfig"
osource "/home/no01eg/zephyrproject/zephyr/arch/arm/Kconfig"
osource "/home/no01eg/zephyrproject/zephyr/arch/arc/Kconfig"
```

## bus485/sample/build/Kconfig/boards/Kconfig
```kconfig
# Load Zephyr board Kconfig descriptions.
osource "/home/no01eg/zephyrproject/zephyr/boards/st/nucleo_f767zi/Kconfig"
```

## bus485/sample/build/Kconfig/boards/Kconfig.defconfig
```kconfig
# Load Zephyr board defconfig descriptions.
osource "/home/no01eg/zephyrproject/zephyr/boards/st/nucleo_f767zi/Kconfig.defconfig"
```

## bus485/sample/build/Kconfig/boards/Kconfig.nucleo_f767zi
```kconfig
# Load board Kconfig descriptions.
osource "/home/no01eg/zephyrproject/zephyr/boards/st/nucleo_f767zi/Kconfig.nucleo_f767zi"
```

## bus485/src/Kconfig
```kconfig
config STRIM_BUS485
    bool "Strim bus485"
    default n 
    depends on UART_INTERRUPT_DRIVEN && GPIO
    help
        Enable the strim bus485 driver.

config STRIM_BUS485_INIT_PRIORITY
    int "Initialization priority"
    default 50
    range 1 100

config STRIM_BUS485_RX_QUEUE_SIZE
    int "Size of receive queue"
    default 256
    range 1 256

config STRIM_BUS485_TX_QUEUE_SIZE
    int "Size of transmit queue"
    default 256
    range 1 256

config STRIM_BUS485_RECV_SYM_IDLE_COUNT
    int "count symbols for wait idle status on bus"
    default 5
    range 3 5

source "subsys/logging/Kconfig.template.log_config"

config STRIM_BUS485_LOG_LEVEL
    int "bus485 driver log level"
    default 4
    range 0 4
    help
        Set the log level for bus485 module. 0=Off, 1=Error, 2=Warning, 3=Info, 4=Debug.
```

## module/Bus485/drivers/Bus485/Kconfig
```kconfig
config CUSTOM_BUS485
    bool "Custom bus485"
    default n 
    depends on GPIO 
    depends on UART
    help
        Enable the custom bus485 driver.
```

## module/Bus485/dts/bindings/serial/custom,bus485.yaml
```yaml
description: Custom bus485

compatible: "custom,bus485"

properties:
  pin:
    type: phandle
    required: true
  uart:
    type: label
    required: true
```

## module/bus485/drivers/bus485/Kconfig
```kconfig
config CUSTOM_BUS485
    bool "Custom bus485"
    default n 
    depends on UART_INTERRUPT_DRIVEN && GPIO
    help
        Enable the custom bus485 driver.

config CUSTOM_BUS485_INIT_PRIORITY
    int "Initialization priority"
    default 50
    range 1 100

config CUSTOM_BUS485_QUEUE_SIZE
    int "Size of receive queue"
    default 256
    range 1 256

config CUSTOM_BUS485_RECV_SYM_IDLE_COUNT
    int "count symbols for wait idle status on bus"
    default 5
    range 3 5

config CUSTOM_BUS485_DE_ACTIVE
    bool "use pin data_enable"
    default y

config CUSTOM_BUS485_CORRECTION_READ_AFTER_WRITE
    bool "read waste single byte after toggle data_enable pin"
    default y
```

## module/bus485/dts/bindings/serial/custom,bus485.yaml
```yaml
description: Custom bus485

compatible: "custom,bus485"

include: uart-device.yaml

properties:
  pin-gpios:
    type: phandle-array
    
```

## west.yml
```yaml
manifest:
  projects:
    - name: zephyr
      revision: main
      url: https://github.com/zephyrproject-rtos/zephyr
  
```
